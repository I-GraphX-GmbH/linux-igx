/*
 * Copyright (C) 2023 I-GraphX GmbH
 *
 * This program is free software; you can redistribute it and/or modify
 * it under the terms of the GNU General Public License version 2 as
 * published by the Free Software Foundation.
 */
 
#define CONFIG_PICOCOREMX8MP_MIPI_DSI_LVDS
#include "x-view.dts"
#include "displays/imx8mp-lcdif-r1024-x-a-b.dtsi"